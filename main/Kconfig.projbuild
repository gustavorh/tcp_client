## main/Kconfig.projbuild
```kconfig
menu "TCP Client Configuration"

    config TCP_CLIENT_WIFI_SSID
        string "WiFi SSID"
        default "YOUR_WIFI_SSID"
        help
            SSID (network name) for the WiFi network to connect to.

    config TCP_CLIENT_WIFI_PASSWORD
        string "WiFi Password"
        default "YOUR_WIFI_PASSWORD"
        help
            WiFi password (WPA or WPA2) for the access point.

    config TCP_CLIENT_MAXIMUM_RETRY
        int "Maximum retry attempts"
        default 5
        help
            Set the maximum number of connection retry attempts if WiFi connection fails.

    config TCP_CLIENT_API_ENDPOINT
        string "API Endpoint URL"
        default "http://192.168.1.122:9000/api/esp32"
        help
            Complete URL of the REST API endpoint where data will be sent.

    config TCP_CLIENT_POST_INTERVAL
        int "Data transmission interval (seconds)"
        default 10
        help
            Interval in seconds between data transmissions to the API.

endmenu 
```

## sdkconfig.defaults
```kconfig
# ESP-IDF Configuration Defaults for TCP Client

# Enable WiFi
CONFIG_ESP_WIFI_ENABLED=y

# WiFi Configuration
CONFIG_ESP32_WIFI_STATIC_RX_BUFFER_NUM=10
CONFIG_ESP32_WIFI_DYNAMIC_RX_BUFFER_NUM=32
CONFIG_ESP32_WIFI_TX_BUFFER_TYPE=1
CONFIG_ESP32_WIFI_DYNAMIC_TX_BUFFER_NUM=32

# TCP/IP Stack
CONFIG_LWIP_MAX_SOCKETS=16
CONFIG_LWIP_SO_REUSE=y
CONFIG_LWIP_SO_RCVBUF=y

# HTTP Client Configuration
CONFIG_ESP_HTTP_CLIENT_ENABLE_HTTPS=y
CONFIG_ESP_TLS_INSECURE=y
CONFIG_ESP_TLS_SKIP_SERVER_CERT_VERIFY=y

# NVS Flash (for storing WiFi credentials)
CONFIG_NVS_ENCRYPTION=n

# JSON Support
CONFIG_JSON_ESCAPE_SOLIDUS=n

# FreeRTOS
CONFIG_FREERTOS_HZ=1000

# Logging
CONFIG_LOG_DEFAULT_LEVEL_INFO=y
CONFIG_LOG_MAXIMUM_EQUALS_DEFAULT=y 
```
